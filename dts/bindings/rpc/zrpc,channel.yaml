## dts/bindings/rpc/zrpc,channel.yaml
```yaml
# Copyright (c) 2026 Vilhelm Engström
#
# SPDX-License-Identifier: Apache-2.0

description: |
  zRPC generic channel.

compatible: zrpc,channel

include: base.yaml

properties:
  zrpc,channel-id:
    type: int
    required: true
    description: |
      Numeric identifier of the channel to attach to the medium.

      Should match the ID of one of the channels in the zRPC configuration file. The RPCs
      defined for said channels are made available for the channel node.

      Must be the same for the two endpoints in a channel.

  zrpc,host:
    type: boolean
    description: |
      Set to configure zRPC node in host mode. Must be set for exactly one of the peers
      in a pair.

      Must be set for exactly one endpoint in a channel.

  zrpc,heap-size:
    type: int
    default: 256
    description: |
      Size of the per-channel heap, in bytes. Used only if CONFIG_ZRPC_HEAP_TYPE_PER_CHANNEL is set.

examples:
  - |
    &sram4 {
      virtio_channel_0: memory@38000000 {
        /* "zrpc,channel" must always be present, regardless of backend */
        compatible = "zrpc,virtio-channel",
                     "zrpc,channel";

        /* Attach RPC channel 0 to this device */
        zrpc,channel-id = <0>;

        /* This endpoint is RPC host */
        zrpc,host;

        /* ... */
      };
    };
```

## dts/bindings/rpc/zrpc,virtio-channel.yaml
```yaml
# Copyright (c) 2026 Vilhelm Engström
#
# SPDX-License-Identifier: Apache-2.0

description: |
  zRPC hypervisorless virtio channel.

include:
  - name: base.yaml
  - name: zrpc,channel.yaml

compatible: zrpc,virtio-channel

properties:
  reg:
    required: true
    description: |
      Address and size of the shared memory area to use.

      Must be the same for both channel endpoints.

  zrpc,virtio-rx-stack-size:
    type: int
    default: 512
    description: |
      Size of the stack of the per-backend RX thread.

  zrpc,virtio-ipm-stack-size:
    type: int
    default: 512
    description: |
      Size of the stack of the per-backend IPM thread.

  zrpc,virtio-ipm-handle:
    type: phandle
    required: true
    description: |
      Handle referring to the inter-process mailbox to use.

      Typically the same for both channel endpoints. Some IPM implementations may, however, require
      the values to differ.

  zrpc,virtio-ctrl-block-size:
    type: int
    default: 0x400
    description: |
      Default size of the shared memory control block.

      The backend reserves this number of bytes at the start of the shared memory section identified
      in the reg property for status flags.

      If unsure, leave unaltered. Must be the same for both endpoints.

  zrpc,virtio-virtqueue-num-extra-descs:
    type: int
    default: 16
    description:
      Number of struct vq_desc_extra instances to place after each virtqueue.

      If unsure, leave unaltered. Should be the same for both endpoints.

  zrpc,virtio-rx-queue-size:
    type: int
    default: 4
    description: |
      Number of entries that may be queued up in the RX queue.

      Queued up data is processed almost immediately. This value should rarely be large.

  zrpc,virtio-copy-rx:
    type: boolean
    description: |
      Copy incoming RPCs to an instance-local memory slab before queueing
      them for dispatch. This releases the shared RPMsg buffer immediately
      and prevents a delayed RX worker from backpressuring the peer.

      Enabling this reserves one transmit-chunk-sized block per RX queue
      entry and concurrent reply.

  zrpc,virtio-reply-queue-size:
    type: int
    default: 4
    description: |
      Number of RPC replies queued up in the driver. This property differs from
      zrpc,virtio-rx-queue-size in that the latter defines the size of a queue used
      internally by the driver to pass data from interrupt to process context whereas
      zrpc,virtio-reply-queue-size determines the size of the queue in which replies
      that have yet to be extracted by user code are buffered.

      Much like zrpc,virtio-rx-queue-size, this property rarely needs to be large.

  zrpc,virtio-max-concurrent-replies:
    type: int
    default: 4
    description: |
      Maximum concurrent number of replies in flight. Once the number is exceeded, newly issued RPCs
      fail until at least one of the outstanding RPCs has completed.

  zrpc,virtio-tx-chunk-size:
    type: int
    default: 512
    description: |
      Size of the memory chunks in which RPCs are transmitted. This setting effectively determines
      the maximum size of RPCs allowed over the channel. At the time of writing, said maximum
      is the value of this property - 16.

      Must be the same for both endpoints.

  zrpc,virtio-reply-lifetime:
    type: int
    default: 2000
    description: |
      Number of milliseconds an RPC is kept in the reply queue before being discarded.

      The longer an RPC remains in the queue, the larger the risk of the latter - the size of
      which is determined by the zrpc,virtio-max-concurrent-replies - the larger the risk of replies
      being discarded due to memory limitations. This risk is furter increased by issuing RPCs at a
      high rate.

  zrpc,virtio-rx-timeout:
    type: int
    default: 2000
    description: |
      Number of milliseconds to block in the zrpc_recv syscall waiting for a message with the
      expected sequence number.

examples: |
  # VirtIO configuration for the STM32H755 Cortex-M7
  -
    /* STM32 HSEM IPM mailbox */
    &mailbox {
      status = "okay";
    };

    /* sram4 is shared between the Cortex-M4 and the Cortex-M7 */
    &sram4 {
      #address-cells = <1>;
      #address-cells = <1>;

      status = "okay";

      zrpc_virtio: memory@38000000 {
        /* "zrpc,channel" must always be present */
        compatible = "zrpc,virtio-channel",
                     "zrpc,channel";

        /* Use the entire region */
        reg = <0x38000000 DT_SIZE_K(64)>;

        /* Must match the ID of the channel specified in the
         * configuration file */
        zrpc,channel-id = <0>;

        /* The Cortex-M7 is master */
        zrpc,host;

        /* Use HSEM-based inter-CPU notifications */
        zrpc,virtio-ipm-handle = <&mailbox>;

        /* Allow RPCs of at most 1024 bytes in size */
        zrpc,virtio-tx-chunk-size = <1024>;

        status = "okay";
      };
    };

  # VirtIO configuration for the STM32H755 Cortex-M4
  -
    /* Use the same IPM implementation as on the Cortex-M7 */
    &mailbox {
      status = "okay";
    };

    &sram4 {
      #address-cells = <1>;
      #address-cells = <1>;

      status = "okay";

      /* Everything but the zrpc,host property will typically match
       * the configuration used on the Cortex-M7 */
      zrpc_virtio: memory@38000000 {
        compatible = "zrpc,virtio-channel",
                     "zrpc,channel";

        reg = <0x38000000 DT_SIZE_K(64)>;

        zrpc,channel-id = <0>;

        /* The Cortex-M4 is slave, leave zrpc,host unset here */

        zrpc,virtio-ipm-handle = <&mailbox>;

        zrpc,virtio-tx-chunk-size = <1024>;

        status = "okay";
      };
    };
```

## subsys/rpc/Kconfig.zrpc
```kconfig
# Copyright (c) 2026 Vilhelm Engström

# SPDX-License-Identifier: Apache-2.0

config ZRPC
	bool "zRPC remote procedure calls"
	default n
	help
	  Enable the zRPC implementation core.

if ZRPC

module = ZRPC
module-str = zRPC
source "subsys/logging/Kconfig.template.log_config"

config ZRPC_USER_DATA_BUCKET_SHIFT
	int "Number of user data buckets"
	default 0
	help
	  RPC servicers that have requested user data are invoked under a lock
	  to ensure that accesses to said data do not race. Thus, RPCs needing
	  user data are subject to limited parallelism. This setting determines
	  the degree of said parallelism.

	  Each RPC channel contains (1 << CONFIG_ZRPC_USER_DATA_BUCKET_SHIFT)
	  locks. Choosing a higher value for this setting will therefore
	  reduce contention at the cost of increased memory usage.

	  Valid choices are 0, 1, 2, 3, 4, 5 or 6.


config ZRPC_PEDANTIC
	bool "Enable pedantic zRPC checks"
	default y
	help
	  Enable pedantic checks to prevent potential exploits. This
	  comes at a small cost in terms of both runtime and binary size.

	  If unsure, say y.

config ZRPC_CONFIGURATION
	string "Path to the zRPC configuration file"
	default ""
	help
	  Path to the zRPC configuration file for the endpoints. Either absolute
	  or relative the west workspace.

choice ZRPC_HEAP_TYPE
	prompt "Type of heap the zRPC core should use"
	default ZRPC_HEAP_TYPE_GLOBAL

config ZRPC_HEAP_TYPE_GLOBAL
	bool "Use global heap"
	help
	  Use a single, global heap for all channels. Typically more memory-efficient
	  but requires less granular locking.

	  Size of the heap is determined by the ZRPC_GLOBAL_HEAP_SIZE configuration option.

config ZRPC_HEAP_TYPE_PER_CHANNEL
	bool "Use per-channel heap"
	help
	  Use per-channel heap. Size of said heap is determined by the zrpc,heap-size
	  devicetree property in the associated node.

endchoice

if ZRPC_HEAP_TYPE_GLOBAL

config ZRPC_GLOBAL_HEAP_SIZE
	int "Size of the zRPC heap"
	default 256
	help
	  Size of the global zRPC heap used to temporarily store encoded RPCs.

endif # ZRPC_GLOBAL_HEAP_SIZE

DT_COMPAT_ZRPC_VIRTIO_CHANNEL = zrpc,virtio-channel
DT_PROP_ZRPC_HOST = zrpc,host

config ZRPC_BACKEND_VIRTIO
	bool "Enable hypervisorless virtio zRPC backend"
	default y
	depends on DT_HAS_ZRPC_VIRTIO_CHANNEL_ENABLED
	select IPM
	select OPENAMP
	select OPENAMP_MASTER if $(dt_compat_any_has_prop,$(DT_COMPAT_ZRPC_VIRTIO_CHANNEL),$(DT_PROP_ZRPC_HOST),True)
	help
	  The hypervisorless virtio zRPC backend enables zRPC over an OpenAMP shared memory
	  channel.

if ZRPC_BACKEND_VIRTIO

config ZRPC_VIRTIO_INIT_PRIORITY
	int "Init priority for the virtio backend"
	default 48
	help
	  Init priority of the virtio zRPC backend.

module = ZRPC_VIRTIO
module-str = zRPC virtio backend
source "subsys/logging/Kconfig.template.log_config"

endif # ZRPC_BACKEND_VIRTIO

endif # ZRPC
```
